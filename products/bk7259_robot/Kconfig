## products/bk7259_robot/Kconfig
```kconfig
menu "BK Open Framework Robot Product"
    config BK_OF_PRODUCT_ROBOT_ENABLE
        bool "Enable bk7259_robot product controller"
        default y
        depends on BK_OF_AI_AGENT_ENABLE && BK_OF_PRODUCT_MOTION_ENABLE && BK_OF_PRODUCT_ROBOT_FACE_ENABLE && BK_OF_PRODUCT_BATTERY_POLICY_ENABLE
endmenu
```

## tools/spikes/bk7259_component_probe/fixture/bk_probe_comp/Kconfig
```kconfig
menu "BK Open Framework Probe"
	config BK_OPEN_FRAMEWORK_PROBE
		bool "Enable BK Open Framework AP/CP component probe"
		default n
		help
			Spike probe option used to verify that an external component
			can be compiled into AP and CP when enabled, and excluded
			from the final ELF when disabled.
endmenu
```
