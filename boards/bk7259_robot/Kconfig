## boards/bk7259_robot/Kconfig
```kconfig
menuconfig BK7259_ROBOT
    bool "BK7259 robot board"
    default y
    help
      Enable the verified BK7259 robot board metadata.

if BK7259_ROBOT

config BK7259_ROBOT_CP_UART0
    bool "Verified CP UART0"
    default y
    help
      CP UART0 uses GPIO10 for RX and GPIO11 for TX.

endif
```

## components/bk_ai_agent/Kconfig
```kconfig
menu "BK Open Framework AI Agent Protocols"
    config BK_OF_AI_AGENT_ENABLE
        bool "Enable BK Open Framework WebSocket transport and Xiaozhi protocol"
        default y
        depends on BK_OF_NET_ENABLE && BK_OF_AUDIO_SESSION_ENABLE

    config BK_XIAOZHI_LEGACY_IOT_COMPAT
        bool "Enable deprecated legacy 'iot' message compatibility in protocol_xiaozhi"
        default n
        depends on BK_OF_AI_AGENT_ENABLE
endmenu
```

## components/bk_audio_mixer/Kconfig
```kconfig
menu "BK Open Framework Audio Mixer"
    config BK_OF_AUDIO_MIXER_ENABLE
        bool "Enable BK Open Framework 20ms PCM Ducking/Preempt mixer"
        default y
        depends on BK_OF_AUDIO_SESSION_ENABLE
endmenu
```

## components/bk_audio_session/Kconfig
```kconfig
menu "BK Open Framework Audio Session"
    config BK_OF_AUDIO_SESSION_ENABLE
        bool "Enable BK Open Framework 20ms PCM audio session and ringbuffer"
        default y
        depends on BK_OF_BOARD_ENABLE && BK_OF_PORT_ENABLE
endmenu
```

## components/bk_board/Kconfig
```kconfig
menu "BK Open Framework Board Abstraction"
    config BK_OF_BOARD_ENABLE
        bool "Enable BK Open Framework board capability and CP template contract"
        default y
endmenu
```

## components/bk_button/Kconfig
```kconfig
menu "BK Open Framework Button FSM"
    config BK_OF_BUTTON_ENABLE
        bool "Enable BK Open Framework button debounce and click FSM"
        default y
        depends on BK_OF_PORT_ENABLE
endmenu
```

## components/bk_common/Kconfig
```kconfig
menu "BK Open Framework Common"
    config BK_OF_COMMON_ENABLE
        bool "Enable BK Open Framework common error and capability contracts"
        default y
endmenu
```

## components/bk_core/Kconfig
```kconfig
menuconfig BK_CORE
    bool "BK core"
    default y
    help
      Enable the chip-independent lifecycle and event APIs.
```

## components/bk_core_event/Kconfig
```kconfig
menu "BK Open Framework Core Event Bus"
    config BK_OF_CORE_EVENT_ENABLE
        bool "Enable BK Open Framework asynchronous event bus"
        default y
        depends on BK_OF_PORT_ENABLE
endmenu
```

## components/bk_esp_compat/Kconfig
```kconfig
menu "BK Open Framework: bk_esp_compat (Espressif Component Compatibility Layer)"
    config BK_OF_ESP_COMPAT_ENABLE
        bool "Enable ESP-IDF / ESP-IoT-Solution compatibility shim (esp_err, esp_timer, nvs, iot_button, led_indicator)"
        default y
        depends on BK_OF_PORT_ENABLE && BK_OF_CORE_EVENT_ENABLE && BK_OF_STORAGE_ENABLE && BK_OF_BUTTON_ENABLE && BK_OF_LED_EFFECT_ENABLE
        help
            Provides header and runtime shims mapping classic Espressif Component Registry
            APIs (esp_err, esp_check, esp_log, esp_heap_caps, esp_timer, esp_event, nvs,
            iot_button, led_indicator) onto bk-open-framework components.
endmenu
```

## components/bk_health/Kconfig
```kconfig
menu "BK Open Framework Health Diagnostics"
    config BK_OF_HEALTH_ENABLE
        bool "Enable BK Open Framework memory/cache health diagnostics"
        default y
        depends on BK_OF_PORT_ENABLE
endmenu
```

## components/bk_led_effect/Kconfig
```kconfig
menu "BK Open Framework LED Effect Queue"
    config BK_OF_LED_EFFECT_ENABLE
        bool "Enable BK Open Framework priority LED effect controller"
        default y
        depends on BK_OF_PORT_ENABLE
endmenu
```

## components/bk_media/Kconfig
```kconfig
menuconfig BK_MEDIA
    bool "Enable BK media component"
    default n
    help
      Enable the chip-independent media adapter boundary.
```

## components/bk_net/Kconfig
```kconfig
menu "BK Open Framework Network & Provisioning"
    config BK_OF_NET_ENABLE
        bool "Enable BK Open Framework Wi-Fi FSM, provisioning, and SNTP/TLS gate"
        default y
        depends on BK_OF_CORE_EVENT_ENABLE && BK_OF_STORAGE_ENABLE
endmenu
```

## components/bk_ota/Kconfig
```kconfig
menu "BK Open Framework: bk_ota (Deferred Target Capability)"
    config BK_OF_OTA_ENABLE
        bool "Enable bk_ota secure upgrade state machine (requires verified OTA partition table)"
        default n
        help
            Enables the bk_ota state machine. Keep disabled (n) on default 8MB
            bk7259_robot partition tables where the 'ota' slot is only 264KB.
endmenu
```

## components/bk_peripheral/Kconfig
```kconfig
menuconfig BK_PERIPHERAL
    bool "Enable BK peripheral component"
    default y
    help
      Enable the chip-independent peripheral capability and lifecycle APIs.
```

## components/bk_port/Kconfig
```kconfig
menu "BK Open Framework Porting Layer"
    config BK_OF_PORT_ENABLE
        bool "Enable BK Open Framework OS/Memory/Cache porting layer"
        default y
endmenu
```

## components/bk_storage/Kconfig
```kconfig
menu "BK Open Framework Secure KV Storage"
    config BK_OF_STORAGE_ENABLE
        bool "Enable BK Open Framework CRC32 KV storage with sensitive scrubbing"
        default y
        depends on BK_OF_PORT_ENABLE
endmenu
```

## components/bk_ui/Kconfig
```kconfig
menuconfig BK_UI
    bool "Enable BK UI component"
    default n
    help
      Enable the chip-independent display and input adapter boundary.
```

## components/bk_ui_core/Kconfig
```kconfig
menu "BK Open Framework UI Core"
    config BK_OF_UI_CORE_ENABLE
        bool "Enable BK Open Framework recursive LVGL lock wrapper"
        default y
        depends on BK_OF_BOARD_ENABLE && BK_OF_PORT_ENABLE
endmenu
```

## components/bk_video_frame_pool/Kconfig
```kconfig
menu "BK Open Framework Video Frame Pool"
    config BK_OF_VIDEO_FRAME_POOL_ENABLE
        bool "Enable BK Open Framework 64B-aligned PSRAM video frame pool"
        default y
        depends on BK_OF_PORT_ENABLE
endmenu
```

## plugins/plugin_agora/Kconfig
```kconfig
menu "BK Open Framework Optional Proprietary Plugins"
    config BK_PLUGIN_AGORA_ENABLE
        bool "Enable optional Agora RTC/RTM proprietary plugin (requires external agora-iot-sdk)"
        default n
endmenu
```

## product_components/bk_battery_policy/Kconfig
```kconfig
menu "BK Open Framework Product Battery Policy"
    config BK_OF_PRODUCT_BATTERY_POLICY_ENABLE
        bool "Enable robot battery threshold and motion cutoff policy"
        default y
        depends on BK_OF_BOARD_ENABLE
endmenu
```

## product_components/bk_motion/Kconfig
```kconfig
menu "BK Open Framework Product Motion Component"
    config BK_OF_PRODUCT_MOTION_ENABLE
        bool "Enable robot servo/motor keyframe interpolation"
        default y
        depends on BK_OF_BOARD_ENABLE
endmenu
```

## product_components/bk_robot_face/Kconfig
```kconfig
menu "BK Open Framework Product Robot Face"
    config BK_OF_PRODUCT_ROBOT_FACE_ENABLE
        bool "Enable robot face emotion view controller"
        default y
        depends on BK_OF_UI_CORE_ENABLE
endmenu
```
